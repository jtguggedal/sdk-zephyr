/* SPDX-License-Identifier: Apache-2.0 */

/ {
	chosen {
		zephyr,bt-c2h-uart=&uart1;
	};
};

&uart1 {
	compatible = "nordic,nrf-uarte";
	current-speed = <1000000>;
	status = "okay";
	hw-flow-control;
	tx-pin = <25>;
	rx-pin = <32>;
	rts-pin = <22>;
	cts-pin = <19>;
};
